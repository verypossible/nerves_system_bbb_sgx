## Config.in
```kconfig
# Add project-specific packages for Buildroot here

source "$NERVES_DEFCONFIG_DIR/package/bb-kf5-extra-cmake-modules/Config.in"
source "$NERVES_DEFCONFIG_DIR/package/bb-libglfw/Config.in"
source "$NERVES_DEFCONFIG_DIR/package/bb-ti-sgx-um/Config.in"
source "$NERVES_DEFCONFIG_DIR/package/bb-weston/Config.in"
source "$NERVES_DEFCONFIG_DIR/package/extra-dts/Config.in"
```

## package/bb-kmscube/Config.in
```kconfig
config BR2_PACKAGE_BB_KMSCUBE
	bool "kmscube"
	depends on BR2_PACKAGE_BB_TI_SGX_UM
	help
	  kmscube is an application to test kms/drm drivers.

	  git://git.ti.com/glsdk/kmscube.git
```

## package/bb-libglfw/Config.in
```kconfig
config BR2_PACKAGE_BB_LIBGLFW
	bool "libglfw"
	depends on BR2_PACKAGE_HAS_LIBGLES

	help
	  GLFW is an Open Source, multi-platform library for creating
	  windows with OpenGL contexts and receiving input and events.

	  http://www.glfw.org

comment "libglfw depends on an OpenGL ES backend"
	depends on !BR2_PACKAGE_HAS_LIBGLES
```
